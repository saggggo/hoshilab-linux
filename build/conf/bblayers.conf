## build/conf/bblayers.conf
```bitbake
# POKY_BBLAYERS_CONF_VERSION is increased each time build/conf/bblayers.conf
# changes incompatibly
POKY_BBLAYERS_CONF_VERSION = "2"

BBPATH = "${TOPDIR}"
BBFILES ?= ""

BBLAYERS ?= " \
  /home/ryota/Projects/poky/meta \
  /home/ryota/Projects/poky/meta-poky \
  /home/ryota/Projects/poky/meta-yocto-bsp \
  /home/ryota/Projects/poky/meta-altera \
  /home/ryota/Projects/poky/build/workspace \
  "
```

## meta-hoshilab/conf/layer.conf
```bitbake
# We have a conf and classes directory, add to BBPATH
BBPATH .= ":${LAYERDIR}"

# We have recipes-* directories, add to BBFILES
BBFILES += "${LAYERDIR}/recipes-*/*/*.bb \
            ${LAYERDIR}/recipes-*/*/*.bbappend"

BBFILE_COLLECTIONS += "meta-hoshilab"
BBFILE_PATTERN_meta-hoshilab = "^${LAYERDIR}/"
BBFILE_PRIORITY_meta-hoshilab = "6"

LAYERDEPENDS_meta-hoshilab = "core"
LAYERSERIES_COMPAT_meta-hoshilab = "thud"
```
